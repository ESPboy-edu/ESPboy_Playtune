#include "lib/User_Setup.h"  //TFT_eSPI setup file for ESPboy
#define USER_SETUP_LOADED


#include <Wire.h>
#include <ESP8266WiFi.h>
#include <Adafruit_MCP23017.h>

#include <TFT_eSPI.h>
TFT_eSPI tft = TFT_eSPI();

#include "lib/ESPboyLogo.h"
#include <ESPboyPlaytune.h>


Adafruit_MCP23017 mcp;

#define MCP23017address 0 // actually it's 0x20 but in <Adafruit_MCP23017.h> lib there is (x|0x20) :)
#define CSTFTPIN        8 //CS MCP23017 PIN to TFT
#define LHSWAP(w)       (((w)>>8)|((w)<<8))

uint16_t line_buffer[46];

boolean outEn() {
  return true;
}
ESPboyPlaytune pt(outEn);

// Playtune bytestream for file "bach_bwv798.mid" created by MIDITONES V1.1 on Sun Feb 27 12:45:00 2011
const byte PROGMEM score_3ch[] = {
  // Sinfonia No.12 in A major BWV.798 J.S.Bach
  // Conductor Track
  7, 208, 0x90, 0x45, 0x91, 0x39, 1, 77, 0x80, 0x81, 0x90, 0x44, 0, 166, 0x80, 0x90, 0x45, 0, 166, 0x80, 0x90, 0x47,
  0x91, 0x38, 1, 77, 0x80, 0x81, 0x90, 0x45, 0, 166, 0x80, 0x90, 0x44, 0, 166, 0x80, 0x90, 0x45, 0x91, 0x36, 1, 77,
  0x81, 1, 77, 0x91, 0x31, 0, 166, 0x80, 0x90, 0x47, 0, 166, 0x80, 0x81, 0x90, 0x44, 0, 166, 0x80, 0x90, 0x45,
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  0x80, 0x81, 0x90, 0x45, 0, 91, 0, 136, 0x80, 0x82, 0x90, 0x45, 0x91, 0x2D, 7, 83, 0x80, 0x81, 0xf0
};
// This score contains 3203 bytes, and 3 tone generators are used.





// Playtune bytestream for file "mapleaf2.mid" created by MIDITONES V1.1 on Sat Feb 26 13:02:34 2011
const byte PROGMEM score_6ch [] = {
  // Maple Leaf Rag
  3, 232, 0x90, 0x27, 0x91, 0x33, 1, 77, 0x81, 0x80, 0x90, 0x2C, 0x91, 0x38, 0, 166, 0x92, 0x44, 0, 166, 0x82,
  0x81, 0x80, 0x90, 0x33, 0x91, 0x3C, 0x92, 0x38, 0x93, 0x3F, 0x94, 0x4B, 0, 166, 0x84, 0x83, 0x93, 0x44, 0, 166, 0x83,
  0x82, 0x81, 0x80, 0x90, 0x33, 0x91, 0x3C, 0x92, 0x38, 0x93, 0x48, 0, 166, 0x83, 0x93, 0x3F, 0x94, 0x4B, 0, 166, 0x80,
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  0x94, 0x2C, 0x95, 0x20, 1, 185, 0x85, 0x81, 0x82, 0x80, 0x84, 0x83, 0xf0
};
// This score contains 10033 bytes, and 6 tone generators are used.
// 2 notes had to be skipped.


void drawCharFast(uint16_t x, uint16_t y, uint8_t c, uint16_t color, uint16_t bg){
 uint16_t i, j, c16, line;
  for (i = 0; i < 5; ++i){
    line = pgm_read_byte(&font[c * 5 + i]);
    for (j = 0; j < 8; ++j){
      c16 = (line & 1) ? color : bg;
      line_buffer[j * 5 + i] = LHSWAP(c16);
      line >>= 1;
    }
  }
  tft.pushImage(x, y, 5, 8, line_buffer);
}


void printFast(int x, int y, String str, int16_t color, uint16_t bg){
 char c, i=0;
  while (1){
    c =  str[i++];
    if (!c) break;
    drawCharFast(x, y, c, color, bg);
    x += 6;
  }
}


void setup()
{
  Serial.begin(115200); //serial init
  delay (100);
  WiFi.mode(WIFI_OFF); // to safe some battery power

//TFT init
  mcp.pinMode(CSTFTPIN, OUTPUT);
  mcp.digitalWrite(CSTFTPIN, LOW);
  tft.begin();
  delay(200);
  tft.setRotation(0);
  tft.fillScreen(TFT_BLACK);

//draw ESPboylogo
  tft.drawXBitmap(30, 20, ESPboyLogo, 68, 64, TFT_YELLOW);
  printFast (12,95,F("ESPboyPlaytune lib"), TFT_YELLOW, TFT_BLACK);

//buttons on mcp23017 init
  mcp.begin(MCP23017address);
  delay (100);
  for (int i = 0; i < 8; i++)
  {
    mcp.pinMode(i, INPUT);
    mcp.pullUp(i, HIGH);
  }

  //pt.setSynth(EPT_SYNTH_SQUARE, 64); //128 for square, less to thinner sound
  pt.setSynth(EPT_SYNTH_PIN, 10); //decrease 10 to even thinner sound
  pt.initChannel(0);  //at least one call is needed to make sound, pin number does not matter
  //pt.tone(440, 1000);
}


void loop()
{
  pt.playScore(score_3ch); /* start playing */  pt.playScore(score_3ch); /* start playing */
  while (pt.playing()) delay(100); /* wait here until playing stops */
  delay(1000);
  pt.playScore(score_6ch); /* start playing */
  while (pt.playing()) delay(100); /* wait here until playing stops */
  delay(1000);
}
